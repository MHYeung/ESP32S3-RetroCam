## main/Kconfig.projbuild
```kconfig
menu "Wi-Fi SoftAP"

    config APP_WIFI_AP_SSID
        string "SoftAP SSID"
        default "ESP32S3-CAM"
        help
            SSID broadcast when SoftAP is toggled on by long-pressing the shutter button.

    config APP_WIFI_AP_PASSWORD
        string "SoftAP password (min 8 chars)"
        default "12345678"
        help
            WPA2 password for the SoftAP.  Must be at least 8 characters.

    config APP_WIFI_AP_CHANNEL
        int "SoftAP Wi-Fi channel"
        default 6
        range 1 13

    config APP_WIFI_AP_MAX_CONN
        int "Max simultaneous AP clients"
        default 2
        range 1 4

endmenu

menu "SD card (1-bit SDMMC, Prusa/diymore style)"

    config APP_SDMMC_PIN_CLK
        int "SD CLK GPIO"
        default 39

    config APP_SDMMC_PIN_CMD
        int "SD CMD GPIO"
        default 38

    config APP_SDMMC_PIN_D0
        int "SD D0 GPIO"
        default 40

endmenu

menu "Tact button"

    config APP_BUTTON_GPIO
        int "Shutter / AP-toggle / triple-tap GPIO (active LOW)"
        default 1
        help
            Short tap: capture JPEG to SD.
            Long press (APP_LONG_PRESS_MS): toggle SoftAP + HTTP gallery.
            Triple-tap at boot (within APP_BOOT_MSC_WINDOW_MS): USB MSC mode.
            GPIO0 is strapping — avoid unless required.

    config APP_BOOT_MSC_WINDOW_MS
        int "Boot window for triple-tap MSC (ms)"
        default 4500
        range 2000 8000

    config APP_LONG_PRESS_MS
        int "Long-press duration to toggle SoftAP (ms)"
        default 2000
        range 500 5000

    config APP_TRIPLE_TAP_WINDOW_MS
        int "Max time for 3 taps to count as triple-tap (ms)"
        default 1200
        range 400 3000

endmenu

menu "Camera capture"

    choice APP_CAMERA_FRAMESIZE
        prompt "JPEG frame size (sensor output)"
        default APP_CAMERA_FRAMESIZE_VGA
        help
            Larger sizes need more PSRAM and bandwidth. VGA is a good default;
            UXGA may fail on some boards or with Wi-Fi active.

        config APP_CAMERA_FRAMESIZE_QVGA
            bool "QVGA 320x240"
        config APP_CAMERA_FRAMESIZE_VGA
            bool "VGA 640x480"
        config APP_CAMERA_FRAMESIZE_SVGA
            bool "SVGA 800x600"
        config APP_CAMERA_FRAMESIZE_XGA
            bool "XGA 1024x768"
        config APP_CAMERA_FRAMESIZE_SXGA
            bool "SXGA 1280x1024"
        config APP_CAMERA_FRAMESIZE_UXGA
            bool "UXGA 1600x1200"
    endchoice

    config APP_CAMERA_JPEG_QUALITY
        int "JPEG quality (0=best, 63=worst)"
        default 10
        range 4 40

    config APP_CAMERA_HMIRROR
        bool "Horizontal mirror (fix left-right reversed text)"
        default y
        help
            Flips the image left-right in the sensor before JPEG encode.
            Enable if saved photos look like a mirror (text reads backwards).

    config APP_CAMERA_VFLIP
        bool "Vertical flip (fix upside-down image)"
        default n
        help
            Flips the image top-bottom. Enable if the scene is upside down,
            or together with H-mirror for 180 degree rotation.

endmenu

menu "Status LED (WS2812)"

    config APP_LED_GPIO
        int "WS2812 data GPIO"
        default 48

endmenu

menu "GC9A01 SPI (SPI2)"

    config APP_LCD_SPI_HOST
        int "SPI host ID (2 = SPI2_HOST)"
        default 2

    config APP_LCD_PIN_SCLK
        int "LCD SPI SCLK"
        default 41

    config APP_LCD_PIN_MOSI
        int "LCD SPI MOSI"
        default 42

    config APP_LCD_PIN_CS
        int "LCD CS"
        default 45

    config APP_LCD_PIN_DC
        int "LCD DC"
        default 46

    config APP_LCD_PIN_RST
        int "LCD RST (-1 if tied to EN on module)"
        default 3

    config APP_LCD_PIN_BL
        int "Backlight GPIO (-1 to disable)"
        default -1

    config APP_LCD_PREVIEW_FPS
        int "Target preview frames per second"
        default 6
        range 1 15

endmenu
```

## sdkconfig.defaults
```kconfig
# Octal PSRAM (typical for ESP32-S3-WROOM-1 N16R8 modules)
# See: https://docs.espressif.com/projects/esp-idf/en/latest/esp32s3/api-guides/flash_psram_config.html
CONFIG_SPIRAM=y
CONFIG_SPIRAM_MODE_OCT=y
CONFIG_SPIRAM_SPEED_80M=y
CONFIG_SPIRAM_FETCH_INSTRUCTIONS=y
CONFIG_SPIRAM_RODATA=y

CONFIG_ESP_DEFAULT_CPU_FREQ_MHZ_240=y

CONFIG_ESP_WIFI_STATIC_RX_BUFFER_NUM=10
CONFIG_ESP_WIFI_DYNAMIC_RX_BUFFER_NUM=32

# Custom partition table: factory app + LittleFS "storage"
CONFIG_PARTITION_TABLE_CUSTOM=y
CONFIG_PARTITION_TABLE_CUSTOM_FILENAME="partitions.csv"
CONFIG_PARTITION_TABLE_FILENAME="partitions.csv"

CONFIG_ESPTOOLPY_FLASHSIZE_16MB=y

# TinyUSB device MSC (triple-tap boot path)
CONFIG_TINYUSB=y
CONFIG_TINYUSB_MSC_ENABLED=y

CONFIG_FATFS_LFN_HEAP=y

# Status LED on GPIO48 (WS2812)
CONFIG_APP_LED_GPIO=48
CONFIG_APP_CAMERA_FRAMESIZE_VGA=y
CONFIG_APP_CAMERA_JPEG_QUALITY=10
CONFIG_APP_CAMERA_HMIRROR=y
CONFIG_APP_CAMERA_VFLIP=n
CONFIG_APP_TRIPLE_TAP_WINDOW_MS=1200
CONFIG_APP_LONG_PRESS_MS=2000

# Avoid secondary console warnings with TinyUSB on USB Serial/JTAG chips
CONFIG_ESP_CONSOLE_SECONDARY_NONE=y
```
